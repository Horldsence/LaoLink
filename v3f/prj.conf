## CMakeLists.txt
```
cmake_minimum_required(VERSION 3.20.0)
find_package(Zephyr REQUIRED HINTS $ENV{ZEPHYR_BASE})

project(v3f)

target_sources(app PRIVATE src/main.c)
```

## prj.conf
```kconfig
# V3F waker configuration

# Wake the V5F application core from soc_early_init_hook().
# The V5F image is expected at flash offset 0x10000.
CONFIG_SOC_CH32H417_BOOT_V5F=y
```

## src/main.c
```c
/*
 * CH32H417EVT V3F waker image.
 *
 * The V3F boot core wakes the V5F application core from
 * soc_early_init_hook() when CONFIG_SOC_CH32H417_BOOT_V5F is enabled.
 * This application does not own peripherals and simply returns to idle.
 */

#include <zephyr/kernel.h>

int main(void)
{
	return 0;
}
```
